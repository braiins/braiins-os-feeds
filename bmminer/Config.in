## bmminer/Config.in
```kconfig
config EXTERNAL_BMMINER_TREE
    string "Use external BMMiner tree" if DEVEL
    default ""
```

## cgminer/Config.in
```kconfig
config EXTERNAL_CGMINER_TREE
    string "Use external CGMiner tree" if DEVEL
    default ""
```

## firmware/Config.in
```kconfig
config FIRMWARE_MAJOR
    string "Firmware major version"
    default ""

config FIRMWARE_VERSION
    string "Firmware version"
    default ""

config FIRMWARE_REQUIRE
    string "Previous firmware version required by this firmware"
    default ""
```

## uboot-miner/Config.in
```kconfig
config EXTERNAL_UBOOT_TREE
    string "Use external Zynq Miner U-Boot tree" if DEVEL
    default ""
```
